/**
  ******************************************************************************
  * @file           : oled.c
  * @brief          : SSD1306 OLED Display Driver Implementation
  *                   128x64 I2C OLED for Demolition Robot Transmitter
  ******************************************************************************
  */

/* Includes ------------------------------------------------------------------*/
#include "oled.h"
#include <stdio.h>

/* Private defines -----------------------------------------------------------*/
#define OLED_CMD            0x00    // Command mode
#define OLED_DATA           0x40    // Data mode
#define OLED_TIMEOUT        100     // I2C timeout in ms

/* SSD1306 Commands */
#define SSD1306_SET_CONTRAST            0x81
#define SSD1306_DISPLAY_ALL_ON_RESUME   0xA4
#define SSD1306_DISPLAY_ALL_ON          0xA5
#define SSD1306_NORMAL_DISPLAY          0xA6
#define SSD1306_INVERT_DISPLAY          0xA7
#define SSD1306_DISPLAY_OFF             0xAE
#define SSD1306_DISPLAY_ON              0xAF
#define SSD1306_SET_DISPLAY_OFFSET      0xD3
#define SSD1306_SET_COMPINS             0xDA
#define SSD1306_SET_VCOM_DETECT         0xDB
#define SSD1306_SET_DISPLAY_CLOCK_DIV   0xD5
#define SSD1306_SET_PRECHARGE           0xD9
#define SSD1306_SET_MULTIPLEX           0xA8
#define SSD1306_SET_LOW_COLUMN          0x00
#define SSD1306_SET_HIGH_COLUMN         0x10
#define SSD1306_SET_START_LINE          0x40
#define SSD1306_MEMORY_MODE             0x20
#define SSD1306_COLUMN_ADDR             0x21
#define SSD1306_PAGE_ADDR               0x22
#define SSD1306_COM_SCAN_INC            0xC0
#define SSD1306_COM_SCAN_DEC            0xC8
#define SSD1306_SEG_REMAP               0xA0
#define SSD1306_CHARGE_PUMP             0x8D
#define SSD1306_EXTERNAL_VCC            0x01
#define SSD1306_SWITCH_CAP_VCC          0x02
#define SSD1306_ACTIVATE_SCROLL         0x2F
#define SSD1306_DEACTIVATE_SCROLL       0x2E
#define SSD1306_SET_VERTICAL_SCROLL_AREA 0xA3
#define SSD1306_RIGHT_HORIZONTAL_SCROLL 0x26
#define SSD1306_LEFT_HORIZONTAL_SCROLL  0x27

/* Private variables ---------------------------------------------------------*/
static I2C_HandleTypeDef *oled_i2c;
static uint8_t oled_buffer[OLED_BUFFER_SIZE];
static uint8_t cursor_x = 0;
static uint8_t cursor_y = 0;

/* Logo bitmap - Aldzama Demolition Robot 128x64px */
static const uint8_t logo_aldzama[] = {
	0xff, 0xff, 0xff, 0xff, 0xff, 0xff, 0xff, 0xff, 0xff, 0xff, 0xff, 0xff, 0xff, 0xff, 0xff, 0xff,
	0xff, 0xff, 0xff, 0xff, 0xff, 0xff, 0xff, 0xff, 0xff, 0xff, 0xff, 0xff, 0xff, 0xff, 0xff, 0xff,
	0xff, 0xff, 0xff, 0xff, 0xff, 0xff, 0xff, 0xff, 0xff, 0xff, 0xff, 0xff, 0xff, 0xff, 0xff, 0xff,
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	0xff, 0xff, 0xff, 0xff, 0xff, 0xff, 0xff, 0xff, 0xff, 0xff, 0xff, 0xff, 0xff, 0xff, 0xff, 0xff
};

/* Font 5x7 (small) - ASCII printable characters */
static const uint8_t font_5x7[][5] = {
    {0x00, 0x00, 0x00, 0x00, 0x00}, // 0x20 (space)
    {0x00, 0x00, 0x5F, 0x00, 0x00}, // 0x21 !
    {0x00, 0x07, 0x00, 0x07, 0x00}, // 0x22 "
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    {0x44, 0x64, 0x54, 0x4C, 0x44}, // 0x7A z
};

/* Private function prototypes -----------------------------------------------*/
static void OLED_WriteCommand(uint8_t cmd);
static void OLED_WriteData(uint8_t *data, uint16_t len);

/**
  * @brief  Initialize OLED display
  * @param  hi2c: I2C handle
  * @retval None
  */
void OLED_Init(I2C_HandleTypeDef *hi2c)
{
    oled_i2c = hi2c;

    HAL_Delay(100); // Wait for OLED to power up

    // Init sequence optimized for SSD1309 (compatible with SSD1306)
    OLED_WriteCommand(SSD1306_DISPLAY_OFF);

    // Display clock divide ratio and oscillator frequency
    OLED_WriteCommand(SSD1306_SET_DISPLAY_CLOCK_DIV);
    OLED_WriteCommand(0xF0);  // SSD1309: Higher frequency for better refresh (default 0x80)

    OLED_WriteCommand(SSD1306_SET_MULTIPLEX);
    OLED_WriteCommand(0x3F);  // 64 MUX ratio for 64-row display

    OLED_WriteCommand(SSD1306_SET_DISPLAY_OFFSET);
    OLED_WriteCommand(0x00);  // No display offset

    OLED_WriteCommand(SSD1306_SET_START_LINE | 0x00);  // Start line 0

    // Charge pump (internal DC/DC converter)
    OLED_WriteCommand(SSD1306_CHARGE_PUMP);
    OLED_WriteCommand(0x14);  // Enable charge pump (0x14) for VCC generated from 3.3V

    OLED_WriteCommand(SSD1306_MEMORY_MODE);
    OLED_WriteCommand(0x00);  // Horizontal addressing mode

    OLED_WriteCommand(SSD1306_SEG_REMAP | 0x01);  // Column address 127 mapped to SEG0
    OLED_WriteCommand(SSD1306_COM_SCAN_DEC);      // Scan from COM[N-1] to COM0

    OLED_WriteCommand(SSD1306_SET_COMPINS);
    OLED_WriteCommand(0x12);  // Alternative COM pin config, disable left/right remap

    // Contrast control - SSD1309 specific
    OLED_WriteCommand(SSD1306_SET_CONTRAST);
    OLED_WriteCommand(0xFF);  // Maximum contrast (0xFF = 255) for clearest display

    // Pre-charge period - SSD1309 optimized
    OLED_WriteCommand(SSD1306_SET_PRECHARGE);
    OLED_WriteCommand(0x22);  // SSD1309: Phase1=2 DCLKs, Phase2=2 DCLKs (0x22) for sharper image

    // VCOM Deselect Level - SSD1309 specific
    OLED_WriteCommand(SSD1306_SET_VCOM_DETECT);
    OLED_WriteCommand(0x35);  // SSD1309 optimal: 0.77*VCC (0x35 = brightest without flicker)

    OLED_WriteCommand(SSD1306_DISPLAY_ALL_ON_RESUME);  // Resume to RAM content display
    OLED_WriteCommand(SSD1306_NORMAL_DISPLAY);         // Normal display (not inverted)
    OLED_WriteCommand(SSD1306_DEACTIVATE_SCROLL);      // Disable scroll
    OLED_WriteCommand(SSD1306_DISPLAY_ON);             // Turn on display

    OLED_Clear();
    OLED_Update();
}

/**
  * @brief  Clear display buffer
  * @retval None
  */
void OLED_Clear(void)
{
    memset(oled_buffer, 0x00, OLED_BUFFER_SIZE);
    cursor_x = 0;
    cursor_y = 0;
}

/**
  * @brief  Update display with buffer content
  * @retval None
  */
void OLED_Update(void)
{
    OLED_WriteCommand(SSD1306_COLUMN_ADDR);
    OLED_WriteCommand(0);
    OLED_WriteCommand(127);

    OLED_WriteCommand(SSD1306_PAGE_ADDR);
    OLED_WriteCommand(0);
    OLED_WriteCommand(7);

    OLED_WriteData(oled_buffer, OLED_BUFFER_SIZE);
}

/**
  * @brief  Set cursor position
  * @param  x: X position (0-127)
  * @param  y: Y position (0-63)
  * @retval None
  */
void OLED_SetCursor(uint8_t x, uint8_t y)
{
    cursor_x = x;
    cursor_y = y;
}

/**
  * @brief  Write character to display
  * @param  ch: Character to write
  * @param  font_size: Font size (0=small, 1=normal, 2=large)
  * @retval None
  */
void OLED_WriteChar(char ch, uint8_t font_size)
{
    if (ch < 0x20 || ch > 0x7A) return;

    const uint8_t *font_data = font_5x7[ch - 0x20];
    uint8_t scale = (font_size == FONT_SIZE_LARGE) ? 2 : 1;

    for (uint8_t i = 0; i < 5; i++)
    {
        for (uint8_t s = 0; s < scale; s++)
        {
            if (cursor_x >= OLED_WIDTH) break;

            for (uint8_t j = 0; j < 8; j++)
            {
                for (uint8_t sy = 0; sy < scale; sy++)
                {
                    uint8_t y = cursor_y + j * scale + sy;
                    if (y < OLED_HEIGHT)
                    {
                        if (font_data[i] & (1 << j))
                            OLED_DrawPixel(cursor_x, y, true);
                    }
                }
            }
            cursor_x++;
        }
    }

    // Space between characters
    cursor_x += scale;
}

/**
  * @brief  Write string to display
  * @param  str: String to write
  * @param  font_size: Font size
  * @retval None
  */
void OLED_WriteString(const char *str, uint8_t font_size)
{
    while (*str)
    {
        OLED_WriteChar(*str++, font_size);
    }
}

/**
  * @brief  Draw pixel
  * @param  x: X position
  * @param  y: Y position
  * @param  color: true=white, false=black
  * @retval None
  */
void OLED_DrawPixel(uint8_t x, uint8_t y, bool color)
{
    if (x >= OLED_WIDTH || y >= OLED_HEIGHT) return;

    if (color)
        oled_buffer[x + (y / 8) * OLED_WIDTH] |= (1 << (y % 8));
    else
        oled_buffer[x + (y / 8) * OLED_WIDTH] &= ~(1 << (y % 8));
}

/**
  * @brief  Draw rectangle outline
  * @param  x: X position
  * @param  y: Y position
  * @param  w: Width
  * @param  h: Height
  * @retval None
  */
void OLED_DrawRect(uint8_t x, uint8_t y, uint8_t w, uint8_t h)
{
    for (uint8_t i = 0; i < w; i++)
    {
        OLED_DrawPixel(x + i, y, true);
        OLED_DrawPixel(x + i, y + h - 1, true);
    }
    for (uint8_t i = 0; i < h; i++)
    {
        OLED_DrawPixel(x, y + i, true);
        OLED_DrawPixel(x + w - 1, y + i, true);
    }
}

/**
  * @brief  Draw filled rectangle
  * @param  x: X position
  * @param  y: Y position
  * @param  w: Width
  * @param  h: Height
  * @retval None
  */
void OLED_FillRect(uint8_t x, uint8_t y, uint8_t w, uint8_t h)
{
    for (uint8_t i = 0; i < w; i++)
    {
        for (uint8_t j = 0; j < h; j++)
        {
            OLED_DrawPixel(x + i, y + j, true);
        }
    }
}

/**
  * @brief  Draw bitmap image (128x64)
  * @param  bitmap: Pointer to bitmap data (1024 bytes)
  * @retval None
  */
static void OLED_DrawBitmap(const uint8_t* bitmap)
{
    memcpy(oled_buffer, bitmap, OLED_BUFFER_SIZE);
}

/**
  * @brief  Show splash screen with messages
  * @retval None
  */
void OLED_ShowSplashScreen(void)
{
    // Screen 1: Aldzama Demolition Robot Logo (2 seconds)
    OLED_Clear();
    OLED_DrawBitmap(logo_aldzama);
    OLED_Update();
    HAL_Delay(2000);

    // Screen 2: Semangat Kerjanya Sayangg (1 second)
    OLED_Clear();
    OLED_SetCursor(10, 24);
    OLED_WriteString("Semangat", FONT_SIZE_LARGE);
    OLED_SetCursor(4, 46);
    OLED_WriteString("Kerjanya Sayangg", FONT_SIZE_NORMAL);
    OLED_Update();
    HAL_Delay(1000);

    // Screen 3: Tetap Jaga Safetynya Yaa (1 second)
    OLED_Clear();
    OLED_SetCursor(20, 24);
    OLED_WriteString("Tetap Jaga", FONT_SIZE_LARGE);
    OLED_SetCursor(12, 46);
    OLED_WriteString("Safetynya Yaa", FONT_SIZE_NORMAL);
    OLED_Update();
    HAL_Delay(1000);
}

/**
  * @brief  Show mode and active cylinders with percentage
  * @param  s5_1: Switch 5_1 state
  * @param  s5_2: Switch 5_2 state
  * @param  joystick_data: Pointer to joystick data array [left_x, left_y, right_x, right_y, r8, r1]
  * @retval None
  */
void OLED_ShowModeScreen(uint8_t s5_1, uint8_t s5_2, const uint8_t* joystick_data, uint8_t sleep_mode, uint8_t safety_ok, uint8_t hold_progress)
{
    OLED_Clear();

    // Title
    OLED_SetCursor(10, 0);
    OLED_WriteString("DEMOLITION ROBOT", FONT_SIZE_NORMAL);

    // Draw separator line
    for (uint8_t i = 0; i < OLED_WIDTH; i++)
    {
        OLED_DrawPixel(i, 10, true);
    }

    // ========================================================================
    // SLEEP MODE - Emergency Display (Highest Priority)
    // ========================================================================
    if (sleep_mode)
    {
        // Draw warning box
        OLED_DrawRect(5, 18, 118, 40);
        OLED_DrawRect(6, 19, 116, 38);  // Double border for emphasis

        // Display SLEEP MODE status
        OLED_SetCursor(18, 24);
        OLED_WriteString("** SLEEP MODE **", FONT_SIZE_NORMAL);

        if (safety_ok)
        {
            // Safety checks PASSED - show hold progress
            if (hold_progress > 0)
            {
                // S2_1 is being held - show progress
                char progress_text[20];
                uint8_t percent = (hold_progress * 100) / 20;  // 20 = S2_1_HOLD_REQUIRED
                snprintf(progress_text, sizeof(progress_text), "Holding: %d%%", percent);

                OLED_SetCursor(28, 32);
                OLED_WriteString(progress_text, FONT_SIZE_NORMAL);

                // Draw progress bar
                uint8_t bar_width = (hold_progress * 100) / 20;  // 0-100 pixels
                OLED_DrawRect(14, 44, 100, 10);  // Progress bar outline
                OLED_FillRect(15, 45, bar_width, 8);  // Filled portion
            }
            else
            {
                // Ready to hold S2_1
                OLED_SetCursor(8, 36);
                OLED_WriteString("Controls Centered", FONT_SIZE_NORMAL);

                OLED_SetCursor(15, 48);
                OLED_WriteString("Hold S2 UP", FONT_SIZE_NORMAL);
            }
        }
        else
        {
            // Safety checks NOT passed - show instructions
            OLED_SetCursor(5, 32);
            OLED_WriteString("Center Joysticks", FONT_SIZE_SMALL);

            OLED_SetCursor(5, 40);
            OLED_WriteString("Set R1 & R8 to 0", FONT_SIZE_SMALL);

            OLED_SetCursor(5, 48);
            OLED_WriteString("Release S0 Button", FONT_SIZE_SMALL);

            OLED_SetCursor(5, 56);
            OLED_WriteString("S1,S2_2,S4,S5 OFF", FONT_SIZE_SMALL);
        }

        return;  // Exit early - don't show normal mode info
    }

    // Extract joystick values
    uint8_t left_x = joystick_data[0];
    uint8_t left_y = joystick_data[1];
    uint8_t right_x = joystick_data[2];
    uint8_t right_y = joystick_data[3];

    // Determine mode
    const char *mode_name;
    char line_buffer[24];

    if (s5_1 == 0 && s5_2 == 0)
    {
        // Mode UPPER - Excavator
        mode_name = "MODE: UPPER";

        OLED_SetCursor(20, 8);
        OLED_WriteString((char*)mode_name, FONT_SIZE_SMALL);

        // Calculate UP/DOWN percentages for all cylinders
        // CYL1: Not used in UPPER mode - always 0%

        // CYL2: right_y < 127 = UP, right_y > 127 = DOWN
        uint8_t c2_up = (right_y < 127) ? ((127 - right_y) * 100) / 127 : 0;
        uint8_t c2_dn = (right_y > 127) ? ((right_y - 127) * 100) / 128 : 0;

        // CYL3: left_y < 127 = DOWN, left_y > 127 = UP
        uint8_t c3_up = (left_y > 127) ? ((left_y - 127) * 100) / 128 : 0;
        uint8_t c3_dn = (left_y < 127) ? ((127 - left_y) * 100) / 127 : 0;

        // CYL4: right_x < 127 = DOWN, right_x > 127 = UP (reversed!)
        uint8_t c4_up = (right_x > 127) ? ((right_x - 127) * 100) / 128 : 0;
        uint8_t c4_dn = (right_x < 127) ? ((127 - right_x) * 100) / 127 : 0;

        // SLEW: left_x < 127 = CCW, left_x > 127 = CW
        uint8_t slew_ccw = (left_x < 127) ? ((127 - left_x) * 100) / 127 : 0;
        uint8_t slew_cw = (left_x > 127) ? ((left_x - 127) * 100) / 128 : 0;

        // Display format: "CYL X UP=XX% DOWN=XX%"
        OLED_SetCursor(0, 16);
        snprintf(line_buffer, sizeof(line_buffer), "CYL2 UP=%d%% DOWN=%d%%", c2_up, c2_dn);
        OLED_WriteString(line_buffer, FONT_SIZE_SMALL);

        OLED_SetCursor(0, 24);
        snprintf(line_buffer, sizeof(line_buffer), "CYL3 UP=%d%% DOWN=%d%%", c3_up, c3_dn);
        OLED_WriteString(line_buffer, FONT_SIZE_SMALL);

        OLED_SetCursor(0, 32);
        snprintf(line_buffer, sizeof(line_buffer), "CYL4 UP=%d%% DOWN=%d%%", c4_up, c4_dn);
        OLED_WriteString(line_buffer, FONT_SIZE_SMALL);

        OLED_SetCursor(0, 40);
        snprintf(line_buffer, sizeof(line_buffer), "SLEW CCW=%d%% CW=%d%%", slew_ccw, slew_cw);
        OLED_WriteString(line_buffer, FONT_SIZE_SMALL);
    }
    else if (s5_1 == 1 && s5_2 == 0)
    {
        // Mode DUAL - Reserved
        mode_name = "MODE: DUAL";

        OLED_SetCursor(25, 14);
        OLED_WriteString((char*)mode_name, FONT_SIZE_NORMAL);

        OLED_SetCursor(20, 32);
        OLED_WriteString("Reserved for", FONT_SIZE_NORMAL);
        OLED_SetCursor(25, 44);
        OLED_WriteString("Future Use", FONT_SIZE_NORMAL);
    }
    else if (s5_1 == 0 && s5_2 == 1)
    {
        // Mode LOWER - Mobility
        mode_name = "MODE: LOWER";

        OLED_SetCursor(20, 8);
        OLED_WriteString((char*)mode_name, FONT_SIZE_SMALL);

        // Calculate Forward/Backward and Up/Down percentages
        // TRACK LEFT: left_y < 127 = Backward, left_y > 127 = Forward
        uint8_t tl_fwd = (left_y > 127) ? ((left_y - 127) * 100) / 128 : 0;
        uint8_t tl_bwd = (left_y < 127) ? ((127 - left_y) * 100) / 127 : 0;

        // TRACK RIGHT: right_y < 127 = Backward, right_y > 127 = Forward
        uint8_t tr_fwd = (right_y > 127) ? ((right_y - 127) * 100) / 128 : 0;
        uint8_t tr_bwd = (right_y < 127) ? ((127 - right_y) * 100) / 127 : 0;

        // OUT LEFT: left_x < 127 = Down, left_x > 127 = Up
        uint8_t ol_up = (left_x > 127) ? ((left_x - 127) * 100) / 128 : 0;
        uint8_t ol_dn = (left_x < 127) ? ((127 - left_x) * 100) / 127 : 0;

        // OUT RIGHT: right_x < 127 = Down, right_x > 127 = Up
        uint8_t or_up = (right_x > 127) ? ((right_x - 127) * 100) / 128 : 0;
        uint8_t or_dn = (right_x < 127) ? ((127 - right_x) * 100) / 127 : 0;

        // Display format
        OLED_SetCursor(0, 16);
        snprintf(line_buffer, sizeof(line_buffer), "TRK L F=%d%% B=%d%%", tl_fwd, tl_bwd);
        OLED_WriteString(line_buffer, FONT_SIZE_SMALL);

        OLED_SetCursor(0, 24);
        snprintf(line_buffer, sizeof(line_buffer), "TRK R F=%d%% B=%d%%", tr_fwd, tr_bwd);
        OLED_WriteString(line_buffer, FONT_SIZE_SMALL);

        OLED_SetCursor(0, 32);
        snprintf(line_buffer, sizeof(line_buffer), "OUT L UP=%d%% DOWN=%d%%", ol_up, ol_dn);
        OLED_WriteString(line_buffer, FONT_SIZE_SMALL);

        OLED_SetCursor(0, 40);
        snprintf(line_buffer, sizeof(line_buffer), "OUT R UP=%d%% DOWN=%d%%", or_up, or_dn);
        OLED_WriteString(line_buffer, FONT_SIZE_SMALL);
    }
    else
    {
        // Invalid mode
        mode_name = "MODE: INVALID";

        OLED_SetCursor(15, 14);
        OLED_WriteString((char*)mode_name, FONT_SIZE_NORMAL);

        OLED_SetCursor(15, 32);
        OLED_WriteString("Check Switch", FONT_SIZE_NORMAL);
        OLED_SetCursor(10, 44);
        OLED_WriteString("Configuration", FONT_SIZE_NORMAL);
    }
}

/**
  * @brief  Write command to OLED
  * @param  cmd: Command byte
  * @retval None
  */
static void OLED_WriteCommand(uint8_t cmd)
{
    uint8_t data[2] = {OLED_CMD, cmd};
    HAL_I2C_Master_Transmit(oled_i2c, OLED_I2C_ADDR, data, 2, OLED_TIMEOUT);
}

/**
  * @brief  Write data to OLED
  * @param  data: Data buffer
  * @param  len: Data length
  * @retval None
  */
static void OLED_WriteData(uint8_t *data, uint16_t len)
{
    uint8_t buffer[len + 1];
    buffer[0] = OLED_DATA;
    memcpy(&buffer[1], data, len);
    HAL_I2C_Master_Transmit(oled_i2c, OLED_I2C_ADDR, buffer, len + 1, OLED_TIMEOUT);
}
